## CMakeLists.txt
```
cmake_minimum_required(VERSION 3.20.0)

include("../../settings.cmake")

find_package(Zephyr)
project(COMMS)

target_sources(app
        PRIVATE FILE_SET HEADERS BASE_DIRS src FILES
        src/main.h
        src/test_client.h
        src/server.h

        PRIVATE
        src/main.c
        src/test_client.c
        src/server.c
)
```

## prj.conf
```kconfig
CONFIG_SERIAL=y
CONFIG_CACHE_MANAGEMENT=y
CONFIG_BUILD_OUTPUT_HEX=y
CONFIG_HW_STACK_PROTECTION=y
CONFIG_WDT_DISABLE_AT_BOOT=y
CONFIG_LOG=y
CONFIG_CONSOLE=y
CONFIG_LIBCSP=y
CONFIG_ARM_MPU=y
CONFIG_THREAD_MONITOR=y
CONFIG_THREAD_NAME=y
CONFIG_HEAP_MEM_POOL_SIZE=2048
CONFIG_UART_CONSOLE=y
CONFIG_POSIX_SYSTEM_INTERFACES=y
CONFIG_LOG_FUNC_NAME_PREFIX_ERR=y
CONFIG_LOG_FUNC_NAME_PREFIX_WRN=y
CONFIG_LOG_FUNC_NAME_PREFIX_INF=y
CONFIG_LOG_DBG_COLOR_BLUE=y
CONFIG_LOG_BACKEND_UART_OUTPUT_DICTIONARY=y
CONFIG_LOG_OUTPUT=y
CONFIG_BUILD_OUTPUT_COMPRESS_DEBUG_SECTIONS=y
```

## app.overlay
```dts
/ {
	aliases {
		transmitter = &uart4;
	};
};

&uart4 {
	status = "okay";
	current-speed = <500000>;

	pinctrl-0 = <&uart4_default>;
	pinctrl-names = "default";
};
```

## src/main.c
```c
#include "main.h"

#include <stdlib.h>
#include <csp/csp.h>
#include <csp/drivers/usart.h>
#include <csp/interfaces/csp_if_lo.h>
#include <zephyr/kernel.h>
#include <zephyr/logging/log.h>
#include <zephyr/sys/printk.h>

#include "server.h"
#include "test_client.h"

LOG_MODULE_REGISTER(main);

static void router_task(void * p1, void * p2, void * p3) {
	ARG_UNUSED(p1);
	ARG_UNUSED(p2);
	ARG_UNUSED(p3);

    /* Here there be routing */
    while (1) {
        csp_route_work();
    }
}

K_THREAD_DEFINE(p_router_thread, 256,
                router_task, NULL, NULL, NULL,
                0, 0, K_TICKS_FOREVER);
typedef struct {
	char name[CSP_IFLIST_NAME_MAX + 1];
	csp_usart_callback_t rx_callback;
	void * user_data;
	csp_usart_fd_t fd;
	struct k_thread rx_thread;
	int cbuf_len;
	uint8_t cbuf[CONFIG_CSP_UART_RX_BUFFER_LENGTH + 1];
} usart_context_t;

int main(void) {
	printk("Size: %d", sizeof(usart_context_t));
	const char * kiss_device = DEVICE_DT_NAME(DT_ALIAS(transmitter));

	LOG_INF("Initialising CSP");

	csp_conf.version = 1;

	/* Init CSP */
	csp_init();

	/* Start router */
	k_thread_start(p_router_thread);

	/* Add interface(s) */
	csp_iface_t * p_iface = NULL;
	const csp_usart_conf_t conf = {
		.device = kiss_device,
		.baudrate = 500000,
		.databits = 8,
		.stopbits = 1,
		.paritysetting = 0,
	};
	const int error = csp_usart_open_and_add_kiss_interface(&conf, CSP_IF_KISS_DEFAULT_NAME, SERVER_ADDRESS, &p_iface);
	if (error != CSP_ERR_NONE) {
		LOG_ERR("failed to add KISS interface [%s], error: %d", kiss_device, error);
		exit(1);
	}
	p_iface->is_default = 1;
	// csp_if_lo.is_default = 1;

	/* Start server thread */
	start_server();

	/* Start client thread */
	// start_client();
}
```

## src/logging.c
```c
#include "logging.h"

#include <ulog/ulog.h>
#include <zephyr/device.h>
#include <zephyr/devicetree.h>
#include <zephyr/kernel.h>
#include <zephyr/drivers/uart.h>


ULOG_SYSTEM_ID(0x3399)

// Protects the device handle
static K_MUTEX_DEFINE(logging_uart_dev_mutex);
// Needed because a mutex doesn't protect against reentrancy
static bool logging_locked = false;
// Device to output to
static const struct device *p_logging_uart_dev;

void logging_init(void)
{
#ifdef CDH_EVALBOARD
    p_logging_uart_dev = DEVICE_DT_GET(DT_NODELABEL(usart1));
#endif
}

bool ulog_external_acquire(void)
{
    // Lock the mutex (we can lock it multiple times in a single thread, careful!)
    const int ret = k_mutex_lock(&logging_uart_dev_mutex, K_NO_WAIT);
    // Couldnt lock the mutex
    if (ret != 0) return false;
    // Logging is locked by the current thread
    if (logging_locked) return false;

    // Set the reentrancy lock
    logging_locked = true;

    return true;
}
void ulog_external_release(void)
{
    // Unlock both locks
    logging_locked = false;
    k_mutex_unlock(&logging_uart_dev_mutex);
}
void ulog_external_write(const uint8_t byte)
{
#ifdef CDH_EVALBOARD
    uart_poll_out(p_logging_uart_dev, byte);
#endif
}
void ulog_external_flush(void)
{
}

void logging_force_reset(void)
{
    // There's nothing to reset
    if (!logging_uart_dev_mutex.lock_count || !logging_locked) return;

    // Reset the flag and destroy the mutex
    logging_locked = false;
    k_mutex_init(&logging_uart_dev_mutex);

    // Force ulog to flush. This may corrupt a frame, and is unsupported.
    ulog__flush();
}
```

## src/logging.h
```c
#pragma once

/**
 * Initialize the logging system
 */
void logging_init(void);

/**
 * Force ulog to reset. This may corrupt the current frame and potentially the next one.
 */
void logging_force_reset(void);
```

## src/logging_adapter.c
```c
#include "logging_adapter.h"

#include <ulog/ulog.h>
#include <zephyr/logging/log_backend.h>
#include <zephyr/logging/log_backend_std.h>
#include <zephyr/logging/log_core.h>

#include "logging.h"

// Buffer to hold the output strings
static uint8_t logging_adapter_buffer[512] = {0};

// ReSharper disable CppParameterMayBeConstPtrOrRef
static int char_out(uint8_t *p_data, const size_t length, void *p_ctx) // NOLINT(*-non-const-parameter)
// ReSharper restore CppParameterMayBeConstPtrOrRef
{
    ARG_UNUSED(p_ctx);

    // Strip trailing newlines
    if (p_data[length - 1] == '\n') {
        p_data[length - 1] = '\0';
    }
    // Add null terminator at the end
    p_data[length] = '\0';

    // Print via ulog depending on the level
    const uint32_t level = *(uint32_t *)p_ctx;
    switch (level) {
        case LOG_LEVEL_ERR:
            ULOG_ERR("{}", (char *)p_data);
            break;
        case LOG_LEVEL_WRN:
            ULOG_WARN("{}", (char *)p_data);
            break;
        case LOG_LEVEL_DBG:
            ULOG_DEBUG("{}", (char *)p_data);
            break;
        case LOG_LEVEL_INF:
        default:
            ULOG_INFO("{}", (char *)p_data);
    }

    return min(length, sizeof(logging_adapter_buffer) - 1);
}
LOG_OUTPUT_DEFINE(log_output, char_out, logging_adapter_buffer, sizeof(logging_adapter_buffer) - 1);


static void logging_adapter_panic(const struct log_backend *const p_backend) {
    ARG_UNUSED(p_backend);

    // We reset the logger in case we were in the middle of sending a frame. This will corrupt that frame but it should
    // let us get crashlogs out
    logging_force_reset();
}


static void logging_adapter_process(const struct log_backend *const p_backend, union log_msg_generic *p_msg) {
    ARG_UNUSED(p_backend);

    // Save the log level to the context
    uint32_t level = log_msg_get_level(&p_msg->log);
    log_output.control_block->ctx = &level;

    const uint32_t flags = log_backend_std_get_flags();
    log_output_msg_process(&log_output, &p_msg->log, flags);
}

static void logging_adapter_dropped(const struct log_backend *const p_backend, const uint32_t cnt) {
    ARG_UNUSED(p_backend);

    log_backend_std_dropped(&log_output, cnt);
}

const static struct log_backend_api log_backend_ulog_api = {
    .process = logging_adapter_process,
    .panic = logging_adapter_panic,
    .dropped = logging_adapter_dropped,
};

LOG_BACKEND_DEFINE(log_backend_ulog, log_backend_ulog_api, true);
```

## src/main.h
```c
#pragma once

/* Server port, the port the server listens on for incoming connections from the client. */
#define SERVER_PORT		10
#define SERVER_ADDRESS		1
```

## src/server.c
```c
#include "server.h"

#include <csp/csp.h>
#include <zephyr/kernel.h>
#include <zephyr/logging/log.h>


#include "main.h"

LOG_MODULE_REGISTER(server);


static void server_task(void * p1, void * p2, void * p3) {
    ARG_UNUSED(p1);
    ARG_UNUSED(p2);
    ARG_UNUSED(p3);

	LOG_INF("Server task started");

	/* Create socket with no specific socket options, e.g. accepts CRC32, HMAC, etc. if enabled during compilation */
	csp_socket_t sock = {0};

	/* Bind socket to all ports, e.g. all incoming connections will be handled here */
	csp_bind(&sock, CSP_ANY);

	/* Create a backlog of 10 connections, i.e. up to 10 new connections can be queued */
	csp_listen(&sock, 10);

	/* Wait for connections and then process packets on the connection */
	while (1) {

		/* Wait for a new connection, 10000 mS timeout */
		csp_conn_t *conn;
		if ((conn = csp_accept(&sock, 10000)) == NULL) {
			/* timeout */
			continue;
		}

		/* Read packets on connection, timeout is 100 mS */
		csp_packet_t *packet;
		while ((packet = csp_read(conn, 50)) != NULL) {
			switch (csp_conn_dport(conn)) {
			case SERVER_PORT:
				/* Process packet here */
				LOG_HEXDUMP_INF(packet->data, packet->length, "Packet received on MY_SERVER_PORT:");
				csp_buffer_free(packet);
				break;

			default:
				/* Call the default CSP service handler, handle pings, buffer use, etc. */
				csp_service_handler(packet);
				break;
			}
		}

		/* Close current connection */
		csp_close(conn);

	}
}

K_THREAD_DEFINE(p_server_thread, 1024,
                server_task, NULL, NULL, NULL,
                0, 0, K_TICKS_FOREVER);

void start_server(void)
{
	k_thread_start(p_server_thread);
}
```

## src/server.h
```c
#pragma once

void start_server(void);
```

## src/test_client.c
```c
#include "test_client.h"

#include <csp/csp.h>
#include <zephyr/logging/log.h>


#include "main.h"

LOG_MODULE_REGISTER(client);

static void client_task(void * p1, void * p2, void * p3) {
    ARG_UNUSED(p1);
    ARG_UNUSED(p2);
    ARG_UNUSED(p3);

    LOG_INF("Client task started");

    unsigned int count = 'A';

    while (1) {

        k_sleep(K_USEC(200000));

        /* Send ping to server, timeout 1000 mS, ping size 100 bytes */
        int __maybe_unused result = csp_ping(SERVER_ADDRESS, 1000, 100, CSP_O_NONE);
        LOG_INF("Ping address: %d, result %d [mS]", SERVER_ADDRESS, result);

        /* Send data packet (string) to server */

        /* 1. Connect to host on 'server_address', port MY_SERVER_PORT with regular UDP-like protocol and 1000 ms timeout */
        csp_conn_t * conn = csp_connect(CSP_PRIO_NORM, SERVER_ADDRESS, SERVER_PORT, 1000, CSP_O_NONE);
        if (conn == NULL) {
            /* Connect failed */
            LOG_ERR("Connection failed");
            return;
        }

        /* 2. Get packet buffer for message/data */
        csp_packet_t * packet = csp_buffer_get(0);
        if (packet == NULL) {
            /* Could not get buffer element */
            LOG_ERR("Failed to get CSP buffer");
            return;
        }

        /* 3. Copy data to packet */
        memcpy(packet->data, "Hello world ", 12);
        memcpy(packet->data + 12, &count, 1);
        memset(packet->data + 13, 0, 1);
        count++;

        /* 4. Set packet length */
        packet->length = (strlen((char *) packet->data) + 1); /* include the 0 termination */

        /* 5. Send packet */
        csp_send(conn, packet);

        /* 6. Close connection */
        csp_close(conn);
    }
}

K_THREAD_DEFINE(p_client_thread, 1024,
                client_task, NULL, NULL, NULL,
                0, 0, K_TICKS_FOREVER);

void start_client(void)
{
    k_thread_start(p_client_thread);
}
```

## src/test_client.h
```c
#pragma once

void start_client(void);
```
