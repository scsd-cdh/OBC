## MIDDLEWARE/MRAM/Kconfig
```kconfig
config MRAM
    bool "SPI MRAM driver"
    depends on SPI
    select FLASH_HAS_DRIVER_ENABLED
    help
      Enable the SPI MRAM flash API driver.
```

## MIDDLEWARE/ULOG/zephyr/Kconfig
```kconfig
config ULOG_AUTO_MANAGED
    def_bool ULOG_USE_UART

menuconfig ULOG
    bool "Enable uLog"

config ULOG_USE_UART
    bool "Enable uLog auto init over uart (via chosen/ulog,usart)"
    depends on ULOG

config ULOG_SYSTEM_ID
    hex "uLog system ID. Should be a unique u16 for every board"
    range 0x0000 0xFFFF
    default 0x0000
    depends on ULOG && ULOG_AUTO_MANAGED

config ULOG_LOG_BACKEND
    bool "Enable uLog logging backend"
    depends on ULOG && ULOG_AUTO_MANAGED && LOG_OUTPUT

config ULOG_LOG_BACKEND_BUFFER_SIZE
    int "uLog logging backend output buffer size"
    depends on ULOG_LOG_BACKEND
    default 512
```

## west.yml
```yaml
manifest:
  remotes:
    - name: zephyrproject-rtos
      url-base: https://github.com/zephyrproject-rtos
    - name: scsd-cdh
      url-base: https://github.com/scsd-cdh
  projects:
    - name: zephyr
      remote: scsd-cdh
      revision: v4.3.0-patch2
      import: true
    - name: libcsp
      remote: scsd-cdh
      revision: v2.1.1
      path: modules/lib/libcsp
  self:
    path: application
```
